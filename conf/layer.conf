## conf/layer.conf
```bitbake
# We have a conf and classes directory, add to BBPATH
BBPATH .= ":${LAYERDIR}"

# We have recipes-* directories, add to BBFILES
BBFILES += "${LAYERDIR}/recipes-*/*/*.bb \
            ${LAYERDIR}/recipes-*/*/*.bbappend"

BBFILE_COLLECTIONS += "meta-zenith"
BBFILE_PATTERN_meta-zenith = "^${LAYERDIR}/"
BBFILE_PRIORITY_meta-zenith = "6"

LAYERDEPENDS_meta-zenith = "core"
LAYERSERIES_COMPAT_meta-zenith = "dunfell"
```
